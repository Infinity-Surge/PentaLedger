## Kconfig
```kconfig
mainmenu "PentaLedger Configuration"

menu "Generate Documentation"
config DOXYGEN_GENERATION
     bool "Generate Doxygen docs from source code"
     help
        This option will build cross referenced documentation, 
        based on properly formatted source code.

config SPHINX_GENERATION
    bool "Generate PDF documentation from source code"
    help
        This option will build the PDF documentation.
endmenu


config UNIT_TESTS
    bool "Enable unit tests"
    help
        This option will enable unit tests.  These unit tests
        depend on BOOST test, and will fail to build if the 
        appropriate boost test framework is not installed.
```

## configs/test_defconfig
```kconfig
#
# Generate Documentation
#
CONFIG_DOXYGEN_GENERATION=y
CONFIG_SPHINX_GENERATION=y
# end of Generate Documentation

CONFIG_UNIT_TESTS=y
```
